## config/west.yml
```yaml
manifest:
  remotes:
    - name: zmkfirmware
      url-base: https://github.com/zmkfirmware
    - name: EllliesProjects
      url-base: https://github.com/EllliesProjects
  projects:
    - name: zmk
      remote: EllliesProjects
      revision: plover-hid-hog-attempt
      import: app/west.yml
  self:
    path: config
```
